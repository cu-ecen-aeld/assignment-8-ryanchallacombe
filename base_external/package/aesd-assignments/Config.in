## base_external/package/aesd-assignments/Config.in
```kconfig
config BR2_PACKAGE_AESD_ASSIGNMENTS
	bool "aesd-assignments"
	help
	  Includes the writer executable, finder.sh and tester.sh in the kernel image.
	  Used to understand buildroot external trees and package builds.
	  updated for assignment 5 part 2 to include aesdsocket application
	  as well as the start-stop-daemon script
```

## base_external/package/aesdchar-module/Config.in
```kconfig
config BR2_PACKAGE_AESDCHAR_MODULE
	bool "aesdchar-module"
	help
	  assignment 8 with aesdchar module
```

## base_external/package/ldd/Config.in
```kconfig
config BR2_PACKAGE_LDD
	bool "ldd"
	help
	  New module LDD, new for AELD assignment 7 part 2. 
	  supports building and installing the misc-modules and scull components into the root filesystem.
```
